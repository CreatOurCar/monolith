## device/firmware/sdkconfig.defaults
```kconfig
# Suppress deprecated TWAI driver warning (IDF v6 — legacy driver/twai.h still used)
CONFIG_TWAI_SUPPRESS_DEPRECATE_WARN=y
# IDF v6 binary is ~50 KB larger (managed components); use 1500 K large partition
CONFIG_PARTITION_TABLE_SINGLE_APP_LARGE=y
```
